## build/Pluto-nRF52840-Dongle-Connect/Kconfig/boards/Kconfig.defconfig.tmp
```kconfig
# Load Zephyr board defconfig descriptions.
osource "C:/ncs/v3.4.0/zephyr/boards/nordic/nrf52840dongle/Kconfig.defconfig"
```

## build/Pluto-nRF52840-Dongle-Connect/Kconfig/boards/Kconfig.sysbuild.tmp
```kconfig
# Load Sysbuild board Kconfig descriptions.
osource "C:/ncs/v3.4.0/zephyr/boards/nordic/nrf52840dongle/Kconfig.sysbuild"
```
